## config/west.yml
```yaml
manifest:
  remotes:
    - name: zmkfirmware
      url-base: https://github.com/zmkfirmware
      # Additional modules containing boards/shields/custom code can be listed here as well.
      # See:
      # - https://zmk.dev/docs/features/modules
      # - https://docs.zephyrproject.org/3.5.0/develop/west/manifest.html#projects
  #  - name: gpeye
  #    url-base: https://github.com/GPeye
  projects:
   # - name: mario-peripheral-animation
   #   remote: gpeye
   #    revision: main 
    - name: eyelash_sofle
      url: https://github.com/a741725193/zmk-sofle
      revision: main
    # NOTE: ZMK pinned to Dec 6, 2025 (pre-Zephyr 4.1) for compatibility
    # External board repository hasn't been updated for Zephyr 4.1 board variants yet
    # TODO: Monitor for board repo Zephyr 4.1 updates, then upgrade ZMK to latest
    # Last checked: March 18, 2026
    - name: zmk
      remote: zmkfirmware
      revision: 83eafcbf9b12226f1d0dbb30a77e6ddc332a4210  # Dec 6, 2025 - pre-Zephyr 4.1
      import: app/west.yml
  self:
    path: boards
```
